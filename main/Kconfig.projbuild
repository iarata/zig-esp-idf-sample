## main/Kconfig.projbuild
```kconfig
menu "Zig Application Selection"

    choice ZIG_APP_ENTRY
        prompt "Zig app entry source"
        default ZIG_APP_MAIN
        help
            Select which Zig source file is compiled as app_main.

        config ZIG_APP_MAIN
            bool "main/app.zig (default)"

        config ZIG_APP_EXAMPLE_SMARTLED_RGB
            bool "main/examples/smartled-rgb.zig"

        config ZIG_APP_EXAMPLE_WIFI_STATION
            bool "main/examples/wifi-station.zig"

        config ZIG_APP_EXAMPLE_DSP_MATH
            bool "main/examples/dsp-math.zig"

        config ZIG_APP_EXAMPLE_WAVESHARE_AXP2101
            bool "main/examples/waveshare-axp2101.zig"

        config ZIG_APP_EXAMPLE_WAVESHARE_QMI8658
            bool "main/examples/waveshare-qmi8658.zig"

        config ZIG_APP_EXAMPLE_PCF85063_RTC
            bool "main/examples/pcf85063-rtc.zig"

        config ZIG_APP_EXAMPLE_ES8311_CODEC
            bool "main/examples/es8311-codec.zig"

        config ZIG_APP_EXAMPLE_ESP_IO_EXPANDER_TCA9554
            bool "main/examples/esp-io-expander-tca9554.zig"

        config ZIG_APP_EXAMPLE_ESP_LCD_SH8601
            bool "main/examples/esp-lcd-sh8601.zig"

        config ZIG_APP_EXAMPLE_ESP_LCD_TOUCH_FT5X06
            bool "main/examples/esp-lcd-touch-ft5x06.zig"

        config ZIG_APP_EXAMPLE_ESP_LCD_TOUCH_CORE
            bool "main/examples/esp-lcd-touch-core.zig"

        config ZIG_APP_EXAMPLE_LVGL_BASIC
            bool "main/examples/lvgl-basic.zig"

        config ZIG_APP_EXAMPLE_LVGL_INTEGRATED_DISPLAY
            bool "main/examples/lvgl-integrated-display.zig"
    endchoice

endmenu

menu "Example Configuration"

    config ESP_WIFI_SSID
        string "WiFi SSID"
        default "myssid"
        help
            SSID (network name) for the example to connect to.

    config ESP_WIFI_PASSWORD
        string "WiFi Password"
        default "mypassword"
        help
            WiFi password (WPA or WPA2) for the example to use.

    choice ESP_WIFI_SAE_MODE
        prompt "WPA3 SAE mode selection"
        default ESP_WPA3_SAE_PWE_BOTH
        help
            Select mode for SAE as Hunt and Peck, H2E or both.
        config ESP_WPA3_SAE_PWE_HUNT_AND_PECK
            bool "HUNT AND PECK"
        config ESP_WPA3_SAE_PWE_HASH_TO_ELEMENT
            bool "H2E"
        config ESP_WPA3_SAE_PWE_BOTH
            bool "BOTH"
    endchoice

    config ESP_WIFI_PW_ID
        string "PASSWORD IDENTIFIER"
        depends on  ESP_WPA3_SAE_PWE_HASH_TO_ELEMENT|| ESP_WPA3_SAE_PWE_BOTH
        default ""
        help
            password identifier for SAE H2E

    config ESP_MAXIMUM_RETRY
        int "Maximum retry"
        default 5
        help
            Set the Maximum retry to avoid station reconnecting to the AP unlimited when the AP is really inexistent.

    choice ESP_WIFI_SCAN_AUTH_MODE_THRESHOLD
        prompt "WiFi Scan auth mode threshold"
        default ESP_WIFI_AUTH_WPA2_PSK
        help
            The weakest authmode to accept in the scan mode.
            This value defaults to ESP_WIFI_AUTH_WPA2_PSK incase password is present and ESP_WIFI_AUTH_OPEN is used.
            Please select ESP_WIFI_AUTH_WEP/ESP_WIFI_AUTH_WPA_PSK incase AP is operating in WEP/WPA mode.

        config ESP_WIFI_AUTH_OPEN
            bool "OPEN"
        config ESP_WIFI_AUTH_WEP
            bool "WEP"
        config ESP_WIFI_AUTH_WPA_PSK
            bool "WPA PSK"
        config ESP_WIFI_AUTH_WPA2_PSK
            bool "WPA2 PSK"
        config ESP_WIFI_AUTH_WPA_WPA2_PSK
            bool "WPA/WPA2 PSK"
        config ESP_WIFI_AUTH_WPA3_PSK
            bool "WPA3 PSK"
        config ESP_WIFI_AUTH_WPA2_WPA3_PSK
            bool "WPA2/WPA3 PSK"
        config ESP_WIFI_AUTH_WAPI_PSK
            bool "WAPI PSK"
    endchoice

endmenu
```
